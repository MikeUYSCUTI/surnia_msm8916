## arch/arm/hotplug/Kconfig
```kconfig
config CLUSTER_PLUG
        bool "Enable cluster-plug cpu hotplug driver"
        default n
        help
          CPU hotplug driver designed for ARM big.LITTLE systems where
          both the big and little CPUs are of the same type. On these
          systems, it preferable to normall use the big cluster, and
          only activate the little cluster for highly parallel loads.
          This hotplug implementation always keeps the big cluster
          online, and only activates the little cluster for heavy
          parallel loads.

config ALUCARD_HOTPLUG
	bool "Enable alucard-hotplug cpu hotplug driver"
 	default y
 	help
 	  Generic Alucard-hotplug cpu hotplug driver for ARM SOCs

config MSM_SLEEPER
 	bool "CPU hotplug driver"
 	default y
 	help
 	  CPU hotplug driver


config ASMP
 bool "Multi-core automatic hotplug support"
 depends on SMP
 default n
 help
   Automatically hotplugs the multiple cpu cores on and off based on cpu load and suspend state


config MAKO_HOTPLUG
 	bool "Mako Hotplug"
 	default n
 	help
 	  Mako Hotplug: A custom hotplug by fransico franco
```
